/include/ "system-conf.dtsi"
/ {
};

&amba {
    axi_bram_ctrl_0: bram-controller@40000000 {
        compatible = "xlnx,axi-bram-ctrl-4.1";
        reg = <0x40000000 0x2000>;           // Base address, 8KB size (2048 words * 4 bytes)
        xlnx,bram-addr-width = <32>;         // Your 32-bit address width
        xlnx,bram-inst-mode = "EXTERNAL";
        xlnx,ecc = <0x0>;
        xlnx,ecc-onoff-reset = <0x0>;
        xlnx,ecc-onoff-register = <0x0>;
        xlnx,fault-inject = <0x0>;
        xlnx,memory-depth = <2048>;          // Your depth of 2048 words
        xlnx,rd-cmd-optimization = <0x0>;
        xlnx,read-latency = <0x1>;
        xlnx,s-axi-ctrl-addr-width = <32>;   // 32-bit AXI address
        xlnx,s-axi-ctrl-data-width = <32>;   // 32-bit AXI data
        xlnx,s-axi-id-width = <12>;          // Typical AXI ID width
        xlnx,single-port-bram = <0x0>;       // Dual port
    };
};